## app/dma2d_unlock_app/Kconfig
```kconfig
#
# For a description of the syntax of this configuration file,
# see the file kconfig-language.txt in the NuttX tools repository.
#

config LVX_USE_DEMO_CONTEST2026_137_DMA2D_UNLOCK_APP
	bool "Contest 2026 team 137 DMA2D RISAF-unlock experiment"
	default n
	depends on STM32_DMA2D_UNLOCK
	---help---
		Enable the contest 2026 team 137 DMA2D RISAF-unlock experiment
		(dma2d_unlock).  Enables an explicit RISAF2 region (RISAF2 governs
		the AXI SRAM at 0x34000000) whitelisting CID0 (DMA2D) and CID1
		(CPU/TDCID), then sweeps the DMA2D master CID 0..7 with a
		register-to-memory SRAM fill and reports which land.  CID0/CID1
		landing plus CID2..7 dropping proves a NuttX-programmed RISAF
		region unblocks DMA-to-SRAM in DEV boot without a custom FSBL.
		Every touched register is restored bit-identical to boot and the
		whitelist always includes CID1, so the CPU can never be locked out.
		Fully on-chip; no external wiring or instrument needed.  Requires
		STM32_DMA2D_UNLOCK.
```

## app/risaf_probe_app/Kconfig
```kconfig
#
# For a description of the syntax of this configuration file,
# see the file kconfig-language.txt in the NuttX tools repository.
#

config LVX_USE_DEMO_CONTEST2026_137_RISAF_PROBE_APP
	bool "Contest 2026 team 137 RISAF firewall write-access probe"
	default n
	depends on STM32_RISAF_PROBE
	---help---
		Enable the contest 2026 team 137 RISAF write-access probe
		(risaf_probe).  Tests whether NuttX firmware can write RISAF
		configuration registers in DEV boot: it writes and reads back a
		CIDCFGR whitelist pattern on a DISABLED RISAF region (BREN stays
		0, so no access enforcement is altered) and restores the original
		value.  If the write sticks, the SRAM RISAF region can be granted
		a DMA master's CID from firmware, unblocking ADR-029/032 without
		flash-boot; if it is RAZ/WI, the RISAF config space is locked to
		higher privilege and a custom FSBL is required (ADR-039).  Fully
		on-chip; no external wiring or instrument.  Requires
		STM32_RISAF_PROBE.
```

## arch/arm/stm32n6/src/Kconfig
```kconfig
#
# For a description of the syntax of this configuration file,
# see the file kconfig-language.txt in the NuttX tools repository.
#

if ARCH_CHIP_STM32N6

menu "STM32N6 Chip Selection"

choice
	prompt "STM32N6 Chip Configuration"
	default ARCH_CHIP_STM32N647X0

config ARCH_CHIP_STM32N647X0
	bool "STM32N647X0"
	select ARCH_CORTEXM55
	select ARCH_HAVE_MPU
	select ARCH_HAVE_FPU
	select ARM_HAVE_MVE
	select ARMV8M_HAVE_ICACHE
	select ARMV8M_HAVE_DCACHE
	select ARMV8M_HAVE_ITCM
	select ARMV8M_HAVE_DTCM

endchoice

endmenu

menu "STM32N6 Clock Configuration"

config STM32N6_USE_HSE
	bool "Use HSE external oscillator"
	default n
	---help---
		Enable HSE (external high-speed oscillator) as clock source.
		If not set, HSI (64MHz internal RC) is used.

config STM32N6_HSE_FREQUENCY
	int "HSE frequency (Hz)"
	default 32000000
	depends on STM32N6_USE_HSE
	---help---
		Frequency of the external HSE oscillator in Hz.

config STM32N6_USE_PLL1
	bool "Enable PLL1 for system clock"
	default n
	---help---
		Configure PLL1 as the CPU/system clock source, using the
		M/N/IC1_DIV parameters from board.h.  PLL1 can be driven
		from either HSI (default) or HSE (if STM32N6_USE_HSE is
		also enabled); it does not require HSE.  A previous
		revision of this option incorrectly declared "depends on
		STM32N6_USE_HSE", which made the HSI+PLL1 combination
		board.h's clock-tree comment documents (and
		stm32n6_rcc.c's rcc_configpll1() already implements via
		its #ifndef CONFIG_STM32N6_USE_HSE branch) unreachable
		from menuconfig.  If not set, system runs directly from
		HSI (or HSE if STM32N6_USE_HSE is set).

endmenu

menu "STM32N6 Peripheral Selection"

config STM32_USART1
	bool "USART1"
	default n
	select USART1_SERIALDRIVER
	select ARCH_HAVE_SERIAL_TERMIOS

config STM32_USART2
	bool "USART2"
	default n
	select USART2_SERIALDRIVER
	select ARCH_HAVE_SERIAL_TERMIOS

config STM32_USART3
	bool "USART3"
	default n
	select USART3_SERIALDRIVER
	select ARCH_HAVE_SERIAL_TERMIOS

config STM32_IWDG
	bool "IWDG (Independent Watchdog)"
	default n
	select WATCHDOG
	---help---
		Enable the Independent Watchdog (IWDG) peripheral for
		system hang detection. Registers as /dev/watchdog0 through
		the NuttX watchdog framework. Uses LSI 32kHz clock.

config STM32_WWDG
	bool "WWDG (Window Watchdog)"
	default n
	select WATCHDOG
	---help---
		Enable the Window Watchdog (WWDG) peripheral. Registers as
		/dev/watchdog1 through the NuttX watchdog framework. APB1
		clocked, with an early-wakeup interrupt backing the optional
		watchdog capture() operation.

config STM32_I2C1
	bool "I2C1"
	default n
	select I2C
	---help---
		Enable I2C1 master mode driver (interrupt-driven).

config STM32_I2C2
	bool "I2C2"
	default n
	select I2C
	---help---
		Enable I2C2 master mode driver (interrupt-driven).

config STM32_I2C4
	bool "I2C4"
	default n
	select I2C
	select I2C_DRIVER
	---help---
		Enable I2C4 master mode driver (polled).  I2C4 is wired to the
		onboard SHT30 temperature/humidity sensor (PB6=SCL, PB7=SDA,
		AF6).  Selects the I2C character driver so /dev/i2c4 is exposed
		for I2CIOC_TRANSFER (ADR-014).

config STM32_EXTI
	bool "EXTI (Extended Interrupt)"
	default n
	---help---
		Enable the EXTI (Extended Interrupt and Event) controller
		driver. Supports GPIO pin edge-triggered interrupts for
		buttons, external events, and wakeup sources.

config STM32_TIM2
	bool "TIM2 (32-bit general-purpose timer)"
	default n
	select TIMER
	---help---
		Enable the TIM2 general-purpose timer as a NuttX timer
		character device (/dev/timerN). TIM2 is a 32-bit timer on
		APB1, driven at a fixed 1 MHz tick (1 us resolution).

config STM32_TIM5
	bool "TIM5 (32-bit one-shot timer)"
	default n
	select ONESHOT
	---help---
		Enable the TIM5 timer as a NuttX one-shot lower-half
		(/dev/oneshot). TIM5 is a 32-bit timer on APB1, run as a
		free-running counter at a 1 MHz tick with an output-compare
		alarm for the one-shot deadline.

config STM32_LPTIM1
	bool "LPTIM1 (low-power timer)"
	default n
	select TIMER
	---help---
		Enable LPTIM1 as a NuttX timer character device (/dev/timerN).
		LPTIM1 is a 16-bit low-power timer clocked from the LSI
		(~32kHz), run here as a plain periodic timer.

config STM32_LPTIM2
	bool "LPTIM2 (low-power timer)"
	default n
	select TIMER
	---help---
		Enable LPTIM2 as a NuttX timer character device (/dev/timerN).
		LPTIM2 is a 16-bit low-power timer on APB4, clocked from the
		LSI (~32kHz), run here as a plain periodic timer.

config STM32_LPTIM3
	bool "LPTIM3 (low-power timer)"
	default n
	select TIMER
	---help---
		Enable LPTIM3 as a NuttX timer character device (/dev/timerN).
		LPTIM3 is a 16-bit low-power timer on APB4, clocked from the
		LSI (~32kHz), run here as a plain periodic timer.

config STM32_LPTIM4
	bool "LPTIM4 (low-power timer)"
	default n
	select TIMER
	---help---
		Enable LPTIM4 as a NuttX timer character device (/dev/timerN).
		LPTIM4 is a 16-bit low-power timer on APB4, clocked from the
		LSI (~32kHz), run here as a plain periodic timer.

config STM32_LPTIM5
	bool "LPTIM5 (low-power timer)"
	default n
	select TIMER
	---help---
		Enable LPTIM5 as a NuttX timer character device (/dev/timerN).
		LPTIM5 is a 16-bit low-power timer on APB4, clocked from the
		LSI (~32kHz), run here as a plain periodic timer.

config STM32_LPTIM2_PWM
	bool "LPTIM2 low-power PWM output (/dev/pwm0)"
	default n
	depends on !STM32_LPTIM2
	select PWM
	---help---
		Expose LPTIM2 as a NuttX PWM character device (/dev/pwm0)
		driving the LPTIM2_CH1 output (PF1, AF3) from the LSI clock.
		PWM mode shares the LPTIM CR/CFGR and is mutually exclusive
		with the plain periodic-timer mode, so this depends on
		STM32_LPTIM2 being off.

config STM32_LPTIM_STOPWAKE
	bool "LPTIM Stop-mode wakeup self-test"
	default n
	depends on STM32_LPTIM3
	---help---
		Build the LPTIM Stop-mode wakeup self-test entry point.  It
		arms LPTIM3 as a one-shot on the LSI, unmasks its EXTI wakeup
		line (IMR2 line 55), puts the CPU into Stop mode, and verifies
		via PWR_CPUCR.STOPF that Stop was genuinely entered and that
		the LPTIM interrupt woke the core.  Destructive to /dev/timer3
		(reprograms LPTIM3), so do not run it concurrently with the
		timer3 drivertest.

config STM32_TIM3_PWM
	bool "TIM3 PWM output (/dev/pwm1)"
	default n
	select PWM
	---help---
		Expose TIM3 as a NuttX PWM character device (/dev/pwm1)
		driving the TIM3_CH1 compare output in PWM mode 1.  The
		waveform is generated internally and is intended to be routed
		on-chip into TIM15 TI1 (via TISEL) for the wire-free capture
		loopback, so no external GPIO pin is claimed.

config STM32_TIM15_CAP
	bool "TIM15 input capture (/dev/cap0)"
	default n
	depends on STM32_TIM3_PWM
	select CAPTURE
	---help---
		Expose TIM15 as a NuttX input-capture character device
		(/dev/cap0) measuring frequency and duty cycle in PWM-input
		mode.  TIM15 TI1 is sourced internally from TIM3 CH1 through
		the TISEL register, so the TIM3 PWM waveform is captured back
		with zero external wiring.  Depends on STM32_TIM3_PWM as the
		loopback signal source.

config STM32_ADC1
	bool "ADC1 (12-bit analog-to-digital converter)"
	default n
	select ANALOG
	select ADC
	---help---
		Enable ADC1 as a NuttX ADC character device (/dev/adc0).
		Samples the chip's internal analog sources (VREFINT) that
		need no external wiring; conversions are software-triggered
		and read back by polling end-of-conversion.

config STM32_ADC2
	bool "ADC2 multi-channel DMA scan (/dev/adc1)"
	default n
	depends on STM32_ADC1
	select STM32_GPDMA
	---help---
		Enable ADC2 as a second NuttX ADC character device
		(/dev/adc1) that scans two chip-internal voltages
		(VBAT + VDDCORE, no external wiring), moves the results by
		GPDMA, and arms the analog watchdog (AWD1).  Shares the ADC
		driver with /dev/adc0 and pulls in the GPDMA controller for
		its peripheral-to-memory transfers.

config STM32_DTS
	bool "DTS (digital temperature sensor, /dev/temp0)"
	default n
	---help---
		Enable the on-chip digital temperature sensor (DTS) as a
		character device (/dev/temp0) that reports the die junction
		temperature.  The sensor is fully internal (no external
		wiring); it runs in continuous mode and read() returns a
		b16_t (Q16.16) Celsius value.  Conversion uses the fixed
		DS14791 characterization constants in integer fixed point,
		so no FPU is required.

config STM32_HASH
	bool "HASH (SHA-256 hardware accelerator)"
	default n
	---help---
		Enable the STM32N6 HASH accelerator.  Provides the arch helper
		stm32n6_sha256() which computes a SHA-256 digest of an in-memory
		buffer in polling mode.  The engine is fully on-chip, so its
		correctness is verifiable against a known SHA-256 test vector
		without any external wiring or instrument.

config STM32_DMA2D
	bool "DMA2D (Chrom-Art graphics accelerator, probe)"
	default n
	---help---
		Enable the STM32N6 DMA2D (Chrom-Art) accelerator.  Currently
		provides the arch helper stm32n6_dma2d_probe(), a one-shot
		register-to-memory fill that grants DMA2D the SRAM region's
		trusted compartment ID via RIFSC and verifies the write landed.
		It determines whether DMA2D can write SRAM in DEV boot (unlike
		GPDMA1, whose CID is fixed by ROM and cannot be granted).  Fully
		on-chip: no external wiring or instrument required.

config STM32_DMA2D_UNLOCK
	bool "DMA2D RISAF-unlock experiment"
	default n
	depends on STM32_DMA2D
	---help---
		Enable the arch helper stm32n6_dma2d_unlock_probe(), the RISAF
		unlock experiment.  The plain DMA2D probe showed the SRAM write
		is dropped by the RISAF default policy (no enabled region), not
		by a region whitelist.  This helper enables an explicit RISAF2
		region (RISAF2 governs the AXI SRAM at 0x34000000) whitelisting
		CID0 (DMA2D) and CID1 (CPU/TDCID), sweeps the DMA2D master CID
		0..7 with an R2M SRAM fill, and reports which land.  CID0/CID1
		landing plus CID2..7 dropping proves a NuttX-programmed RISAF
		region unblocks DMA-to-SRAM in DEV boot without a custom FSBL.
		Every touched register is restored bit-identical to boot and the
		whitelist always includes CID1, so the CPU can never be locked
		out of its own SRAM.  Requires STM32_DMA2D.

config STM32_RISAF_PROBE
	bool "RISAF firewall write-access probe"
	default n
	---help---
		Enable the arch helper stm32n6_risaf_probe(), a one-shot test of
		whether NuttX firmware can write RISAF configuration registers in
		DEV boot.  It targets a disabled RISAF region (BREN stays 0, so no
		access enforcement is altered), writes then reads back a CIDCFGR
		whitelist pattern, and restores the original value.  The result
		decides ADR-039: if the write sticks, ADR-029/032 DMA-to-SRAM can
		be unblocked from firmware without flash-boot; if it is RAZ/WI, the
		RISAF config space is locked to higher privilege and a custom FSBL
		is required.  Fully on-chip: no external wiring or instrument.

config STM32_RISAF_EARLY_PROBE
	bool "RISAF early-boot region map + writability probe"
	default n
	---help---
		Run stm32n6_risaf_early_probe() from __start_c(), after the console
		is up but before nx_start() (heap not yet initialised).  This is the
		earliest safe boot window and the timing ADR-039 argues a real
		DMA->SRAM unlock should use.  The probe is purely observational: it
		dumps the ACTIVE (BREN=1) region map of the SRAM firewalls (RISAF2
		governs the CPU code/stack SRAM, RISAF21/22 the AXI SRAM banks) so
		the region covering the running firmware can be told apart from free
		address space, and re-confirms CIDCFGR is firmware-writable this
		early on the disabled RISAF21 REG[0] scratch region.  Enables no
		region, sets no GLOCK, restores every value; it proves feasibility
		of an early unlock without performing it.  Output goes to the
		console via arm_lowputc() ("risaf-early: ..." lines).

config STM32_RTC
	bool "RTC (Real-Time Clock)"
	default n
	select RTC_DATETIME
	---help---
		Enable the RTC peripheral for calendar date/time.
		Uses LSI ~32kHz clock source. Provides time for
		file system timestamps and alarm functionality.

config STM32_GPDMA
	bool "GPDMA (General Purpose DMA)"
	default n
	select DMA
	---help---
		Enable the GPDMA (General Purpose DMA) controller for
		memory-to-memory, memory-to-peripheral, and
		peripheral-to-memory transfers.

config STM32_SPI1
	bool "SPI1"
	default n
	select SPI
	---help---
		Enable SPI1 master mode driver.

config STM32_SPI2
	bool "SPI2"
	default n
	select SPI
	---help---
		Enable SPI2 master mode driver.

config STM32_SDMMC1
	bool "SDMMC1 (SD Card)"
	default n
	select MMCSD
	---help---
		Enable SDMMC1 driver for SD card storage.

config STM32_XSPI1
	bool "XSPI1 (External SPI Flash)"
	default n
	---help---
		Enable XSPI1 driver for external NOR/NAND Flash.

config STM32_EMAC
	bool "Ethernet MAC (GMAC)"
	default n
	select NET
	select NETDEV
	---help---
		Enable Ethernet GMAC driver for network connectivity.

config STM32_SAI1
	bool "SAI1 (Serial Audio Interface)"
	default n
	select AUDIO
	---help---
		Enable SAI1 driver for audio input/output.

config STM32_FDCAN1
	bool "FDCAN1 (CAN Bus)"
	default n
	select CAN
	---help---
		Enable FDCAN1 driver for CAN bus communication.

config STM32_OTG
	bool "USB OTG HS"
	default n
	select USBDEV
	---help---
		Enable USB OTG HS device controller.

config STM32_RNG
	bool "RNG (Random Number Generator)"
	default n
	select ARCH_HAVE_RNG
	---help---
		Enable the STM32N6 hardware random number generator.
		Provides /dev/random and optionally /dev/urandom.

endmenu

endif
```
